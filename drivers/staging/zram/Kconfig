## drivers/staging/zram/Kconfig
```kconfig
config ZRAM
	tristate "Compressed RAM block device support"
	depends on BLOCK
	default n
	help
	  Creates virtual block devices called /dev/zramX (X = 0, 1, ...).
	  Pages written to these disks are compressed and stored in memory
	  itself. These disks allow very fast I/O and compression provides
	  good amounts of memory savings.

	  It has several use cases, for example: /tmp storage, use as swap
	  disks and maybe many more.

	  See zram.txt for more information.
	  Project home: http://compcache.googlecode.com/

choice ZRAM_COMPRESS
	prompt "compression method"
	depends on ZRAM
	default ZRAM_LZO
	help
	  Select the compression method used by zram.
config ZRAM_LZO
	bool "LZO compression"
	depends on LZO_COMPRESS
	depends on LZO_DECOMPRESS
config ZRAM_SNAPPY
	bool "Snappy compression"
	depends on SNAPPY_COMPRESS
	depends on SNAPPY_DECOMPRESS
endchoice
```
